## sdkconfig.defaults
```kconfig
# ESP32-S3-Touch-LCD-3.49 V2 Desktop Clock Configuration
CONFIG_IDF_TARGET="esp32s3"
CONFIG_APP_RETRIEVE_LEN_ELF_SHA=16
CONFIG_ESPTOOLPY_FLASHSIZE_16MB=y
CONFIG_PARTITION_TABLE_CUSTOM=y
CONFIG_COMPILER_OPTIMIZATION_PERF=y
CONFIG_ESP_DEFAULT_CPU_FREQ_MHZ_240=y
CONFIG_PM_ENABLE=y

# Octal PSRAM 8MB @ 80MHz
CONFIG_SPIRAM=y
CONFIG_SPIRAM_MODE_OCT=y
CONFIG_SPIRAM_SPEED_80M=y

# FreeRTOS & Network
CONFIG_FREERTOS_HZ=1000
CONFIG_LWIP_SNTP_MAX_SERVERS=3
CONFIG_HTTPD_MAX_REQ_HDR_LEN=1024
CONFIG_HTTPD_MAX_URI_LEN=512

# LVGL v8 Configuration
CONFIG_LV_COLOR_DEPTH_16=y
CONFIG_LV_COLOR_16_SWAP=y
CONFIG_LV_MEM_CUSTOM=y
CONFIG_LV_MEMCPY_MEMSET_STD=y
CONFIG_LV_ATTRIBUTE_FAST_MEM_USE_IRAM=y
CONFIG_LV_DISP_DEF_REFR_PERIOD=15
CONFIG_LV_INDEV_DEF_READ_PERIOD=15
CONFIG_LV_THEME_DEFAULT_GROW=n
CONFIG_LV_THEME_DEFAULT_TRANSITION_TIME=0
CONFIG_LV_FONT_FMT_TXT_LARGE=y
CONFIG_LV_FONT_MONTSERRAT_12=y
CONFIG_LV_FONT_MONTSERRAT_14=y
CONFIG_LV_FONT_MONTSERRAT_16=y
CONFIG_LV_FONT_MONTSERRAT_20=y
CONFIG_LV_FONT_MONTSERRAT_24=y
CONFIG_LV_USE_QRCODE=y
CONFIG_LV_USE_CANVAS=y
CONFIG_LV_USE_ANIMATION=y
CONFIG_LV_USE_SHADOW=n
CONFIG_LV_USE_DEMO_WIDGETS=n
```
